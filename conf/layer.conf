## conf/machine/raptor.conf
```bitbake
#@TYPE: Machine
#@NAME: raptor machine
#@DESCRIPTION: Machine configuration for running Raptor

SOC_FAMILY = "r8a779g0"

DEFAULTTUNE ?= "cortexa76"
require conf/machine/include/arm/armv8-2a/tune-cortexa76.inc
require conf/machine/include/rcar-common.inc

WKS_FILE = "image-v4x.wks"

# Raptor kernel configure
RTX_KERNEL_URL = "git://git@github.com/RetronixTechInc/rcar-gen4-kernel.git;protocol=ssh"
RTX_KERNEL_BRANCH = "v4h-raptor/v5.10.235/rcar-5.2.2.rc2"
RTX_KERNEL_REV = "${AUTOREV}"
RTX_KERNEL_EXTRA_CONFIGS = " \
	file://config_codec_max98357a.cfg \
	file://config_spi_msiof.cfg \
	file://config_builtin_lt9611.cfg \
	file://config_max9295a.cfg \
	file://config_max96752.cfg \
	file://config_USB_XHCI_PCI_RENESAS.cfg \
"

KERNEL_DEVICETREE = " \
	renesas/r8a779g0-raptor.dtb \
	renesas/r8a779g0-raptor-overlay-pcie1x4.dtb \
	renesas/r8a779g0-raptor-overlay-dsi0-7.dtb \
	renesas/r8a779g0-raptor-overlay-dsi0-10.dtb \
	renesas/r8a779g0-raptor-overlay-dsi1-7.dtb \
	renesas/r8a779g0-raptor-overlay-dsi1-10.dtb \
"

# Raptor u-boot configure
UBOOT_CONFIG ??= "raptor"
UBOOT_CONFIG[raptor] = "r8a779g0_raptor_defconfig"

RTX_UBOOT_URL = "git://git@github.com/RetronixTechInc/rcar-uboot.git;protocol=https"
RTX_UBOOT_BRANCH = "v4h-raptor/v2022.01/rcar-6.0.0.rc13"
RTX_UBOOT_REV = "${AUTOREV}"
RTX_UBOOT_EXTRA_CONFIGS = ""

# Set Image & SDK name for Raptor
IMAGE_NAME = "${IMAGE_BASENAME}-v4h${IMAGE_VERSION_SUFFIX}"
IMAGE_LINK_NAME = "${IMAGE_BASENAME}-v4h"
SDK_NAME_r8a779g0 = "${DISTRO}-${TCLIBC}-${SDKMACHINE}-${IMAGE_BASENAME}-${TUNE_PKGARCH}-v4h"

# machine specific package
IMAGE_INSTALL:append:raptor = " \
	linux-firmware-renesas \
	wireless-regdb-static \
"

PREFERRED_PROVIDER_virtual/egl = "${@bb.utils.contains('MACHINE_FEATURES', 'gsx', 'gles-user-module', '', d)}"
PREFERRED_PROVIDER_virtual/libgles2 = "${@bb.utils.contains('MACHINE_FEATURES', 'gsx', 'gles-user-module', '', d)}"
BBMASK += "${@bb.utils.contains('MACHINE_FEATURES', 'gsx', '', 'meta-renesas/meta-rcar-adas/recipes-graphics/mesa/ \
                                meta-renesas/meta-rcar-adas/recipes-kernel/kernel-module-gles/ \
                                meta-renesas/meta-rcar-adas/recipes-graphics/gles-user-module/', d)}"
```

## conf/machine/v4h-sbc.conf
```bitbake
#@TYPE: Machine
#@NAME: sbc machine
#@DESCRIPTION: Machine configuration for running SBC

SOC_FAMILY = "r8a779g0"

DEFAULTTUNE ?= "cortexa76"
require conf/machine/include/tune-cortexa76.inc
require conf/machine/include/rcar-common.inc

WKS_FILE = "image-v4x-sbc.wks"

# add IMAGE_BOOT_FILES for bootimg-partition in wks file
IMAGE_BOOT_FILES += "u-boot.bin r8a779g0-sbc.dtb Image"

# Device tree for V4H
KERNEL_DEVICETREE = " \
    renesas/r8a779g0-sbc.dtb \
    renesas/r8a779g0-sbc-rpi-dsi-7inch-overlay.dtb \
"

# V4H u-boot configure
UBOOT_CONFIG ??= "sbc"
UBOOT_CONFIG[sbc] = "r8a779g0_sbc_defconfig"

# Set Image & SDK name for V4H
IMAGE_NAME = "${IMAGE_BASENAME}-v4h${IMAGE_VERSION_SUFFIX}"
IMAGE_LINK_NAME = "${IMAGE_BASENAME}-v4h"
SDK_NAME_r8a779g0 = "${DISTRO}-${TCLIBC}-${SDKMACHINE}-${IMAGE_BASENAME}-${TUNE_PKGARCH}-v4h"

DISTRO_FEATURES_remove = "${@bb.utils.contains('MACHINE_FEATURES', 'gsx', 'opengl', '', d)}"

PREFERRED_PROVIDER_virtual/egl = "${@bb.utils.contains('MACHINE_FEATURES', 'gsx', 'gles-user-module', '', d)}"
PREFERRED_PROVIDER_virtual/libgles2 = "${@bb.utils.contains('MACHINE_FEATURES', 'gsx', 'gles-user-module', '', d)}"
BBMASK += "${@bb.utils.contains('MACHINE_FEATURES', 'gsx', '', 'meta-renesas/meta-rcar-adas/recipes-graphics/mesa/ \
                                meta-renesas/meta-rcar-adas/recipes-kernel/kernel-module-gles/ \
                                meta-renesas/meta-rcar-adas/recipes-graphics/gles-user-module/', d)}"
```

## recipes-kernel/linux/linux-fitimage/fit-image.its
```
/dts-v1/;

/ {
	description = "Linux kernel and FDT blob for r8a779g3-sparrow-hawk";

	images {
		kernel-1 {
			description = "Linux kernel";
			data = /incbin/("./Image");
			type = "kernel";
			arch = "arm64";
			os = "linux";
			compression = "none";
			load = <0x48080000>;
			entry = <0x48080000>;
			hash-1 {
				algo = "crc32";
			};
		};
		fdt-1 {
			description = "Flattened Device Tree blob";
			data = /incbin/("./r8a779g3-sparrow-hawk.dtb");
			type = "flat_dt";
			arch = "arm64";
			compression = "none";
			load = <0x48000000>;
			entry = <0x48000000>;
			hash-1 {
				algo = "crc32";
			};
		};

		script {
			description = "Boot script for automatic applying dt-overlay ";
			data = /incbin/("./boot.cmd");
			type = "script";
			arch = "arm64";
			os = "u-boot";
			compression = "none";
			hash-1 {
				algo = "crc32";
			};
		};

		fdt-j1-imx219 {
			description = "Flattened Device Tree Overlay";
			data = /incbin/("./r8a779g3-sparrow-hawk-camera-j1-imx219.dtb");
			type = "flat_dt";
			arch = "arm64";
			compression = "none";
			hash-1 {
				algo = "crc32";
			};
		};
		fdt-j2-imx219 {
			description = "Flattened Device Tree Overlay";
			data = /incbin/("./r8a779g3-sparrow-hawk-camera-j2-imx219.dtb");
			type = "flat_dt";
			arch = "arm64";
			compression = "none";
			hash-1 {
				algo = "crc32";
			};
		};
		fdt-rpi-display-2-7in {
			description = "Flattened Device Tree Overlay";
			data = /incbin/("./r8a779g3-sparrow-hawk-rpi-display-2-7in.dtb");
			type = "flat_dt";
			arch = "arm64";
			compression = "none";
			hash-1 {
				algo = "crc32";
			};
		};		
	};

	configurations {
		default = "default";
		default {
			description = "Boot Linux kernel with FDT blob";
			kernel = "kernel-1";
			fdt = "fdt-1";
			hash-1 {
				algo = "crc32";
			};
		};

		j1-imx219 {
			fdt = "fdt-j1-imx219";
		};
		j2-imx219 {
			fdt = "fdt-j2-imx219";
		};
		rpi-display-2-7in {
			fdt = "fdt-rpi-display-2-7in";
		};		
	};
};
```
