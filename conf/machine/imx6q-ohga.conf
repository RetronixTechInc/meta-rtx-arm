## conf/machine/imx6q-ohga.conf
```bitbake
#@TYPE: Machine
#@NAME: NXP i.MX6Q SABRE Smart Device
#@SOC: i.MX6Q
#@DESCRIPTION: Machine configuration for NXP i.MX6Q SABRE Smart Device
#@MAINTAINER: Otavio Salvador <otavio@ossystems.com.br>

MACHINEOVERRIDES =. "mx6:mx6q:"

require conf/machine/include/imx6sabresd-common.inc

MACHINE_FEATURES_append = " optee"

PREFERRED_PROVIDER_u-boot = "u-boot-rtx"
PREFERRED_PROVIDER_virtual/bootloader = "u-boot-rtx"
PREFERRED_PROVIDER_virtual/bootloader_mx6 = "u-boot-rtx"
PREFERRED_VERSION_u-boot-imx = "2015.04"
UBOOT_MAKE_TARGET = "u-boot.imx"
UBOOT_SUFFIX = "imx"
UBOOT_PADDING = "2"
UBOOT_CONFIG ??= "pitx"
UBOOT_CONFIG[pitx] = "rtx_pitx_mx6q_nanya1g_dtb_rtx_all_linux_defconfig"

# kernel
PREFERRED_PROVIDER_virtual/kernel_mx6 = "linux-rtx"
PREFERRED_PROVIDER_virtual/kernel_mx6ul = "linux-rtx"
PREFERRED_PROVIDER_virtual/kernel_mx7 = "linux-rtx"
PREFERRED_PROVIDER_virtual/kernel = "linux-rtx"
PREFERRED_VERSION_linux-rtx_mx6 = "4.9.87"
KERNEL_IMAGETYPE = "uImage"
KERNEL_DEVICETREE = "rtx-imx6q-pitx-b21.dtb"

KERNEL_DEVICETREE = "rtx-imx6q-pitx-b21.dtb"
KERNEL_IMAGETYPE = "uImage"
SERIAL_CONSOLE = "115200 ttymxc1"


MACHINE_FIRMWARE_append_mx6 = " linux-firmware-ath6k"

MACHINE_FEATURES += " pci wifi bluetooth"

OPTEE_BIN_EXT = "6qsdb"
```

## conf/machine/imx8mm_cse.conf
```bitbake
#@TYPE: Machine
#@NAME: RTX i.MX8MM Board
#@SOC: i.MX8MM
#@DESCRIPTION: Machine configuration for RTX i.MX8MMini Board
#@MAINTAINER: alstonlai@retronix.com.tw

MACHINEOVERRIDES =. "mx8:mx8m:mx8mm:"

require conf/machine/include/imx-base-cse.inc
require conf/machine/include/arm/arch-arm64.inc

MACHINE_FEATURES += " pci wifi bluetooth optee qca9377 qca6174"

# kernel
PREFERRED_PROVIDER_virtual/kernel_mx8 = "linux-rtx"
PREFERRED_PROVIDER_virtual/kernel = "linux-rtx"
PREFERRED_VERSION_linux-rtx_mx8 = "4.14.98"
KERNEL_CONFIG = "rtx-imx8mm-cse_defconfig"
# Device tree for i.MX8MM LPDDR4 EVK
KERNEL_DEVICETREE = "freescale/rtx-imx8mm-cse.dtb"

IMAGE_BOOTFILES_DEPENDS += "imx-m4-demos:do_deploy"
IMAGE_BOOTFILES += "imx8mm_m4_TCM_hello_world.bin \
                    imx8mm_m4_TCM_rpmsg_lite_pingpong_rtos_linux_remote.bin \
                    imx8mm_m4_TCM_rpmsg_lite_str_echo_rtos.bin \
                    imx8mm_m4_TCM_sai_low_power_audio.bin \
"

PREFERRED_PROVIDER_u-boot = "u-boot-rtx"
PREFERRED_PROVIDER_virtual/bootloader = "u-boot-rtx"
PREFERRED_PROVIDER_virtual/bootloader_mx8 = "u-boot-rtx"
PREFERRED_VERSION_u-boot-imx = "2018.03"
UBOOT_CONFIG ??= "sd"
UBOOT_CONFIG[sd] = "imx8mm_cse_defconfig"
UBOOT_CONFIG[fspi] = "imx8mm_evk_fspi_defconfig"
SPL_BINARY = "spl/u-boot-spl.bin"

# Set DDR FIRMWARE
DDR_FIRMWARE_NAME = "lpddr4_pmu_train_1d_imem.bin lpddr4_pmu_train_1d_dmem.bin lpddr4_pmu_train_2d_imem.bin lpddr4_pmu_train_2d_dmem.bin"

# Set u-boot DTB
UBOOT_DTB_NAME = "rtx-imx8mm-cse.dtb"

# Set imx-mkimage boot target
IMXBOOT_TARGETS = "flash_evk"

SERIAL_CONSOLES = "115200;ttymxc1"

IMAGE_BOOTLOADER = "imx-boot-rtx"

IMAGE_ROOTFS_ALIGNMENT_mx8 = "65536"
BOOT_SPACE = "65536"
# IMAGE_ROOTFS_SIZE = "3145728"
IMAGE_OVERHEAD_FACTOR="1.0"

LOADADDR = ""
UBOOT_SUFFIX = "bin"
UBOOT_MAKE_TARGET = ""
IMX_BOOT_SEEK = "33"

# Add additional firmware
MACHINE_FIRMWARE_append = " linux-firmware-ath10k"
```
